## conf/layer.conf
```bitbake
# We have a conf and classes directory, add to BBPATH
BBPATH .= ":${LAYERDIR}"

# We have recipes-* directories, add to BBFILES
BBFILES += "${LAYERDIR}/recipes-*/*/*.bb \
            ${LAYERDIR}/recipes-*/*/*.bbappend"

BBFILE_COLLECTIONS += "meta-myhardware"
BBFILE_PATTERN_meta-myhardware = "^${LAYERDIR}/"
BBFILE_PRIORITY_meta-myhardware = "6"

LAYERDEPENDS_meta-myhardware = "core"
LAYERSERIES_COMPAT_meta-myhardware = "kirkstone langdale"
```

## conf/machine/hw-u96.conf
```bitbake
MACHINEOVERRIDES =. "u96v2-sbc-base:ultra96:ultra96-zynqmp:u96v2-sbc:"
HDF_MACHINE = "u96v2-sbc-base"

HDF_BASE = "file://"
HDF_PATH = "/mnt/TDG_512/projects/axi_mcdma/output_products/top_bd_wrapper.xsa"
#HDF_PATH = "/mnt/Misc_512/avnet/petalinux/projects/u96v2_sbc_base_2023_2/project-spec/hw-description/system.xsa"
require conf/machine/include/u96v2-sbc.inc

KERNEL_CLASSES:append = " kernel-fitimage"
KERNEL_IMAGETYPES:append = " fitImage vmlinux Image.gz"


#--------------------------------------------------------------------------------------------------
#test

BOOTMODE = "generic"
BOOTFILE_EXT = ""
RAMDISK_IMAGE:${MACHINE} = "rootfs.cpio.gz.u-boot"
RAMDISK_IMAGE1:${MACHINE} = "ramdisk.cpio.gz.u-boot"
KERNEL_IMAGE:${MACHINE} = "Image"
DEVICETREE_OFFSET:${MACHINE} = "0x100000"
KERNEL_OFFSET:${MACHINE} = "0x200000"
RAMDISK_OFFSET:${MACHINE} = "0x4000000"
QSPI_KERNEL_OFFSET:${MACHINE} = "0xF00000"
QSPI_KERNEL_SIZE:${MACHINE} = "0x1D00000"
QSPI_RAMDISK_OFFSET:${MACHINE} = "0x4000000"
QSPI_RAMDISK_SIZE:${MACHINE} = "0x4000000"
QSPI_FIT_IMAGE_OFFSET:${MACHINE} = "0xF40000"
QSPI_FIT_IMAGE_SIZE:${MACHINE} = "0x6400000"
NAND_KERNEL_OFFSET:${MACHINE} = "0x4100000"
NAND_KERNEL_SIZE:${MACHINE} = "0x3200000"
NAND_RAMDISK_OFFSET:${MACHINE} = "0x7800000"
NAND_RAMDISK_SIZE:${MACHINE} = "0x3200000"
NAND_FIT_IMAGE_OFFSET:${MACHINE} = "0x4180000"
NAND_FIT_IMAGE_SIZE:${MACHINE} = "0x6400000"
FIT_IMAGE:${MACHINE} = "image.ub"
FIT_IMAGE_OFFSET:${MACHINE} = "0x10000000"
PRE_BOOTENV:${MACHINE} = ""
IMAGE_FSTYPES:zynqmp = "tar.gz ext4 ext4.gz wic"


EXTRA_IMAGEDEPENDS:append = " virtual/bootloader virtual/fsbl virtual/pmu-firmware arm-trusted-firmware qemu-devicetrees pmu-rom-native u-boot-xlnx-scr"

#--------------------------------------------------------------------------------------------------
#@TYPE: Machine
#@NAME: u96v2-sbc-base-xczu3eg
#@DESCRIPTION: Machine configuration for the u96v2-sbc-base-xczu3eg boards.

#### Preamble
##MACHINEOVERRIDES =. "${@['', 'u96v2-sbc-base-xczu3eg:']['u96v2-sbc-base-xczu3eg' !='${MACHINE}']}"
#### Regular settings follow

# Yocto device-tree variables
YAML_CONSOLE_DEVICE_CONFIG:pn-device-tree ?= "psu_uart_1"
YAML_MAIN_MEMORY_CONFIG:pn-device-tree ?= "PSU_DDR_0"
DT_PADDING_SIZE:pn-device-tree ?= "0x1000"
DTC_FLAGS:pn-device-tree ?= "-@"
YAML_DT_BOARD_FLAGS ?= "{BOARD template}"

# Yocto u-boot-xlnx variables
UBOOT_MACHINE ?= "xilinx_zynqmp_virt_defconfig"

# Yocto arm-trusted-firmware(TF-A) variables
ATF_CONSOLE_DEFAULT ?= "cadence1"
TFA_BL33_LOAD ?= "0x8000000"

# Yocto PMUFW variables
YAML_COMPILER_FLAGS:append:pn-pmu-firmware = " "
YAML_SERIAL_CONSOLE_STDIN:pn-pmu-firmware ?= "psu_uart_1"
YAML_SERIAL_CONSOLE_STDOUT:pn-pmu-firmware ?= "psu_uart_1"

# Yocto FSBL variables
YAML_SERIAL_CONSOLE_STDIN:pn-fsbl-firmware ?= "psu_uart_1"
YAML_SERIAL_CONSOLE_STDOUT:pn-fsbl-firmware ?= "psu_uart_1"

# Yocto KERNEL Variables
UBOOT_ENTRYPOINT  ?= "0x200000"
UBOOT_LOADADDRESS ?= "0x200000"

# u96v2-sbc-base-xczu3eg Serial Console
SERIAL_CONSOLES ?= "115200;ttyPS0"
YAML_SERIAL_CONSOLE_BAUDRATE ?= "115200"

# Set DDR Base address for u-boot-xlnx-scr variables
DDR_BASEADDR ?= "0x0"
SKIP_APPEND_BASEADDR ?= "0"

# Required generic machine inclusion
##require conf/machine/u96v2-sbc-base.conf

# Add system XSA
HDF_EXT = "xsa"
##HDF_BASE = "file://"
##HDF_PATH = "/mnt/Misc_512/avnet/petalinux/projects/u96v2_sbc_base_2023_2/project-spec/hw-description/system.xsa"

#### No additional settings should be after the Postamble
#### Postamble
##PACKAGE_EXTRA_ARCHS:append = "${@['', ' u96v2_sbc_base_xczu3eg']['u96v2-sbc-base-xczu3eg' != '${MACHINE}']}"




MACHINE_FEATURES+="mcdma"
```

## conf/machine/myhardware-u96v2-zynqmp.conf
```bitbake
#require conf/machine/u96v2-sbc-base.conf
require conf/machine/ultra96-zynqmp.conf
HDF_BASE = "file://"
HDF_PATH = "/mnt/TDG_512/projects/axi_mcdma/output_products/top_bd_wrapper.xsa" 



#MACHINE_FEATURES:remove = "wifi bluetooth qemu-usermode mali400 usbhost usbgadget ext3 rtc"

# this shouldn't be here maybe, in local.conf temporarily. make a conf/distro in my layer??
#DISTRO_FEATURES:remove = "wifi bluetooth"



##MACHINE_FEATURES=" mali400 rtc ext2 ext3 vfat usbhost usbgadget   qemu-usermode"
##MACHINE_FEATURES_BACKFILL="rtc qemu-usermode"
##MACHINE_FEATURES_BACKFILL_CONSIDERED=" rtc"
```

## conf/machine/myhardware-zc702-zynq.conf
```bitbake
require conf/machine/zc702-zynq7.conf
HDF_BASE = "file://"
HDF_PATH = "/mnt/TDG_512/projects/zc702/output_products/top_bd_wrapper.xsa"
```

## conf/machine/u96-avnet.conf
```bitbake
require conf/machine/u96v2-sbc-base.conf
HDF_BASE = "file://"
HDF_PATH = "/mnt/TDG_512/projects/axi_mcdma/output_products/top_bd_wrapper.xsa" 
```
